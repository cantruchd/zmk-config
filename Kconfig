## app/nice_view_custom_widgets/Kconfig.defconfig
```kconfig
# File: config/boards/shields/nice_view/Kconfig.defconfig

if SHIELD_NICE_VIEW || SHIELD_NICE_VIEW_ADAPTER

config ZMK_WIDGET_TEMPERATURE
    bool "Enable temperature display on nice_view"
    select SENSOR
    select TEMP_NRF5
    help
      Enable temperature sensor reading and display on nice_view.
      Temperature will replace the random art (balloon/mountain).

endif
```

## boards/shields/nice_view_custom/Kconfig.defconfig
```kconfig
# Copyright (c) 2023 The ZMK Contributors
# SPDX-License-Identifier: MIT

if SHIELD_NICE_VIEW_CUSTOM

config LV_Z_VDB_SIZE
    default 100

config LV_DPI_DEF
    default 161

config LV_Z_BITS_PER_PIXEL
    default 1

choice LV_COLOR_DEPTH
    default LV_COLOR_DEPTH_1
endchoice

choice ZMK_DISPLAY_WORK_QUEUE
    default ZMK_DISPLAY_WORK_QUEUE_DEDICATED
endchoice

choice ZMK_DISPLAY_STATUS_SCREEN
    default ZMK_DISPLAY_STATUS_SCREEN_CUSTOM
endchoice

config LV_Z_MEM_POOL_SIZE
    default 4096 if ZMK_DISPLAY_STATUS_SCREEN_CUSTOM

config ZMK_DISPLAY_STATUS_SCREEN_CUSTOM
    imply NICE_VIEW_WIDGET_STATUS

config NICE_VIEW_WIDGET_STATUS
    bool "Custom nice!view status widget"
    select LV_FONT_MONTSERRAT_16
    select LV_USE_IMG
    select LV_USE_CANVAS
    select LV_FONT_MONTSERRAT_26
	select LV_FONT_MONTSERRAT_24
	select LV_FONT_MONTSERRAT_22
	select LV_FONT_MONTSERRAT_20
	select LV_FONT_MONTSERRAT_18

config NICE_VIEW_WIDGET_INVERTED
    bool "Invert custom status widget colors"

if !ZMK_SPLIT || ZMK_SPLIT_ROLE_CENTRAL

config NICE_VIEW_WIDGET_STATUS
    select LV_FONT_MONTSERRAT_18
    select LV_FONT_MONTSERRAT_14
    select LV_FONT_MONTSERRAT_26
    select LV_FONT_UNSCII_8
    select ZMK_WPM

endif # !ZMK_SPLIT || ZMK_SPLIT_ROLE_CENTRAL

config ZMK_DISPLAY_STATUS_SCREEN_BUILT_IN
    select LV_FONT_MONTSERRAT_26

config ZMK_WIDGET_TEMPERATURE
    bool "Temperature widget"
    depends on ZMK_DISPLAY
    default n
    help
      Enable the temperature widget on the custom status screen.
	  
endif # SHIELD_NICE_VIEW_CUSTOM


# Trong Kconfig.defconfig hoặc nice_view_custom.conf
config ZMK_BATTERY_VOLTAGE_PROXY
    default y
```

## boards/shields/nice_view_custom/dts/bindings/behaviors/zmk,behavior-uptime-reset.yaml
```yaml
description: Behavior to reset uptime counter

compatible: "zmk,behavior-uptime-reset"

include: base.yaml

properties:
  "#binding-cells":
    type: int
    const: 0
```

## config/west.yml
```yaml
manifest:
  defaults:
    revision: main
  
  remotes:
    - name: zmkfirmware
      url-base: https://github.com/zmkfirmware
    - name: cantruchd
      url-base: https://github.com/cantruchd 

  projects:
    - name: zmk
      remote: cantruchd
      import: app/west.yml
      revision: mainfromzmk
    - name: nice_view_gem
      remote: cantruchd
      revision: main

  self:
    path: config
```
